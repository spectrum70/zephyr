## dts/bindings/ethernet/adi,adin1100-phy.yaml
```yaml
# Copyright (c) 2024 BayLibre, SAS
# Copyright (c) 2010-2024 Analog Devices Inc.
# SPDX-License-Identifier: Apache-2.0

description: ADIN1100 PHY

compatible: "adi,adin1100-phy"

include: phy.yaml

on-bus: mdio

properties:
  reg:
    required: true
    description: 5-bit physical/port address (PRTAD).
  led0-en:
    type: boolean
    description: Enable LED 0.
  led1-en:
    type: boolean
    description: Enable LED 1.
  disable-tx-mode-24v:
    type: boolean
    description: |
      Disables requirement of 2.4V TX operating mode in the AN advertisement.
```

## dts/bindings/mdio/st,stm32-mdio.yaml
```yaml
# Copyright 2024 BayLibre, SAS
# Copyright 2010-2024 Analog Devices Inc.
# SPDX-License-Identifier: Apache-2.0

description: ST MDIO Features

compatible: "st,stm32-mdio"

include: [mdio-controller.yaml, pinctrl-device.yaml]

properties:
  pinctrl-0:
    required: true

  pinctrl-names:
    required: true
```
